## package/thirdparty/eventlircd/Config.in
```kconfig
config BR2_PACKAGE_EVENTLIRCD
        bool "eventlircd"
        help
          Remote Control Driver/Daemon for hid devices
```

## package/thirdparty/inputlirc/Config.in
```kconfig
config BR2_PACKAGE_INPUTLIRC
	bool "inputlirc"
        help
          Inputlirc binary
```
